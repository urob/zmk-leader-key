/*
 * Copyright (c) 2024 The ZMK Contributors
 *
 * SPDX-License-Identifier: MIT
 */

#include <dt-bindings/zmk/behaviors.h>

 / {
    behaviors {
#if ZMK_BEHAVIOR_OMIT(LEADER)
        /omit-if-no-ref/
#endif
        leader: leader {
            compatible = "zmk,behavior-leader-key";
            #binding-cells = <0>;
        };
    };
};
