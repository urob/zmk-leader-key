## Kconfig
```kconfig
menu "Leader Options"

config ZMK_LEADER_MAX_KEYS_PER_SEQUENCE
    int "Maximum number of key presses in a leader sequence"
    default 5

config ZMK_LEADER_MAX_SEQUENCES
    int "Maximum number of leader sequences"
    default 32

#Leader options
endmenu

DT_COMPAT_ZMK_BEHAVIOR_LEADER_KEY := zmk,behavior-leader-key

config ZMK_BEHAVIOR_LEADER_KEY
    bool
    default $(dt_compat_enabled,$(DT_COMPAT_ZMK_BEHAVIOR_LEADER_KEY))
```

## dts/bindings/behaviors/zmk,behavior-leader-key.yaml
```yaml
# Copyright (c) 2024 The ZMK Contributors
# SPDX-License-Identifier: MIT

description: Leader key behavior

compatible: "zmk,behavior-leader-key"

include: zero_param.yaml

properties:
  ignore-keys:
    type: array
    description: |
      List of key codes that are passed through without being considered when
      checking for leader key sequences.
    default: []

child-binding:
  description: "A leader sequence"

  properties:
    bindings:
      type: phandle-array
      required: true
    sequence:
      type: array
      required: true
```
